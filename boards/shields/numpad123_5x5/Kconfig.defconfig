## boards/shields/numpad123_5x5/Kconfig.defconfig
```kconfig
if SHIELD_NUMPAD123_5X5

# Name must be less than 16 characters long!
config ZMK_KEYBOARD_NAME
    default "numpad123-5x5"

endif

if SHIELD_NUMPAD123_5X5_DONGLE

# Name must be less than 16 characters long!
config ZMK_KEYBOARD_NAME
    default "numpad123-5x5"

config ZMK_SPLIT
    default y

config ZMK_SPLIT_ROLE_CENTRAL
    default y

config ZMK_SPLIT_BLE_CENTRAL_PERIPHERALS
  default 1

config BT_MAX_CONN
  default 6

config BT_MAX_PAIRED
  default 6

endif

# ---------------------
# Kconfig for shield "numpad123_5x5" with board "nice_nano_v2"
# ---------------------
if BOARD_NICE_NANO_V2 && SHIELD_NUMPAD123_5X5

config SPI
    default y

config WS2812_STRIP
    default y

config I2C
    default y

config ZMK_DISPLAY
    default y

if ZMK_DISPLAY

config I2C
    default y

config SSD1306
    default y

endif # ZMK_DISPLAY

if LVGL

config LV_Z_VDB_SIZE
    default 64

config LV_DPI_DEF
    default 148

config LV_Z_BITS_PER_PIXEL
    default 1

choice LV_COLOR_DEPTH
    default LV_COLOR_DEPTH_1
endchoice

endif # LVGL

endif
```

## boards/shields/numpad123_5x5/Kconfig.shield
```kconfig
config SHIELD_NUMPAD123_5X5
    def_bool $(shields_list_contains,numpad123_5x5)

config SHIELD_NUMPAD123_5X5_DONGLE
    def_bool $(shields_list_contains,numpad123_5x5_dongle)
```
